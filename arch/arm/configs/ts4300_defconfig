## arch/arm/mach-cns3xxx/Kconfig
```kconfig
menu "CNS3XXX platform type"
	depends on ARCH_CNS3XXX

config MACH_CNS3420VB
	bool "Support for CNS3420 Validation Board"
	select MIGHT_HAVE_PCI
	help
	  Include support for the Cavium Networks CNS3420 MPCore Platform
	  Baseboard.
	  This is a platform with an on-board ARM11 MPCore and has support
	  for USB, USB-OTG, MMC/SD/SDIO, SATA, PCI-E, etc.

config MACH_TS43XX
	   bool "TS-4300 platform"
	   select ARM_GIC	
	   select NEED_MACH_MEMORY_H
	   help
	   Include support for the Technologic Systems TS-43XX board.  This
	   is based on the CNS3XXX ARM11 MPCore SoC.	  

	   
config SILICON
	bool
	default y if (MACH_CNS3XXX=y || MACH_TS43XX=y)
        help
	  Interrupt ID	Source		Function	Trigger Type
	  ---		-------------	-------------	----------------
	  32		clkscale_intr	PMU		rising edge
	  33		sdio_intr	SDIO		high level
	  34		l2cc_intr	L2CC		high level
	  35		rtc_intr	RTC		high level
	  36		i2s_intr	I2S		high level
	  37		pcm_intr_n	PCM		high level
	  38		spi_intr_n	SPI		high level
	  39		i2c_intr_n	I2C		high level
	  40		cim_intr	CIM		high level
	  41		gpu_intr	GPU		high level
	  42		lcd_intr	LCD		high level
	  43		gpioa_intr	GPIOA		programmable
	  44		gpiob_intr	GPIOB		programmable
	  45		irda0_intr	UART0		high level
	  46		irda1_intr	UART1		high level
	  47		irda2_intr	UART2		high level
	  48		arm11_intr	ARM11		high level
	  49		swsta_intr	PSE Status 	high level
	  50		tstc_r0_intr	PSE R0TxComplete rising edge
	  51		fstc_r0_intr	PSE R0RxComplete rising edge
	  52		tsqe_r0_intr	PSE R0QEmpty 	rising edge
	  53		tsqe_r0_intr	PSE R0QFull 	rising edge
	  54		tstc_r1_intr	PSE R1TxComplete rising edge
	  55		fstc_r1_intr	PSE R1RxComplete rising edge
	  56		tsqe_r1_intr	PSE R1QEmpty 	rising edge
	  57		tsqe_r1_intr	PSE R1QFull 	rising edge
	  58		hnat_intr	PPE 		high level
	  59 		crypto_intr	CRYPTO		high level
	  60		hcie_intr	HCIE 		rising edge
	  61		pcie0_intr	PCIE0 Device	high level
	  62		pcie1_intr	PCIE1 Device	high level
	  63		usbotg_intr	USB OTG		high level
	  64		ehci_intr	USB EHCI	high level
	  65		sata_intr	SATA		high level
	  66		raid_intr_n	RAID		high level
	  67		smc_intr_n	SMC		high level
	  68		dmac_abort_intr	DMAC		high level
	  86:69		dmac_intr[17:0]	DMAC		high level
	  87		pcie0_rc_intr	PCIE0 RC	high level
	  88		pcie1_rc_intr	PCIE1 RC	high level
	  89		timer1_intr	TIMER 1		high level
	  90		timer2_intr	TIMER 2		high level
	  91		ochi_intr_n	USB OCHI	high level
	  92		timer3_intr	TIMER 3		high level
	  93		ext_intr0	Extrenal Pin	programmable
	  94		ext_intr1	Extrenal Pin	programmable
	  95		ext_intr2	Extrenal Pin	programmable

	   
endmenu
```
